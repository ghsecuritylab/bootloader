#include "stm32f1xx_hal.h"
#include "user_config.h"
#include "user_io.h"
#include "spi_lcd.h"
#include "delay.h"
#include "stdio.h"
#include <stdarg.h>

void Lcd_Init(void);
void Lcd_Clear(uint16_t Color);

void spi_lcd_init(void)
{
	Lcd_Init();		
	Lcd_Clear(BLACK);
}

//向液晶屏写一个8位指令
void Lcd_WriteIndex(uint8_t Index)
{
	//SPI 写命令时序开始
	LCD_CS_CLR();
	LCD_DC_CLR();
	spi1_write_byte(Index);
	LCD_CS_SET();
}

//向液晶屏写一个8位数据
void Lcd_WriteData(uint8_t Data)
{
	LCD_CS_CLR();
	LCD_DC_SET();
	spi1_write_byte(Data);
	LCD_CS_SET(); 
}
//向液晶屏写一个16位数据
void LCD_WriteData_16Bit(uint16_t Data)
{
	LCD_CS_CLR();
	LCD_DC_SET();
	spi1_write_byte(Data>>8); 	//写入高8位数据
	spi1_write_byte(Data); 			//写入低8位数据
	LCD_CS_SET(); 
}

void Lcd_WriteReg(uint8_t Index,uint8_t Data)
{
	Lcd_WriteIndex(Index);
	Lcd_WriteData(Data);
}

void Lcd_Reset(void)
{
	LCD_RST_CLR();
	delay_ms(100);
	LCD_RST_SET();
	delay_ms(50);
}

//LCD Init For 1.44Inch LCD Panel with ST7735R.
void Lcd_Init(void)
{	
	Lcd_Reset(); //Reset before LCD Init.

	//LCD Init For 1.44Inch LCD Panel with ST7735R.
	Lcd_WriteIndex(0x11);//Sleep exit 
	delay_ms (120);
		
	//ST7735R Frame Rate
	Lcd_WriteIndex(0xB1); 
	Lcd_WriteData(0x01); 
	Lcd_WriteData(0x2C); 
	Lcd_WriteData(0x2D); 

	Lcd_WriteIndex(0xB2); 
	Lcd_WriteData(0x01); 
	Lcd_WriteData(0x2C); 
	Lcd_WriteData(0x2D); 

	Lcd_WriteIndex(0xB3); 
	Lcd_WriteData(0x01); 
	Lcd_WriteData(0x2C); 
	Lcd_WriteData(0x2D); 
	Lcd_WriteData(0x01); 
	Lcd_WriteData(0x2C); 
	Lcd_WriteData(0x2D); 

	Lcd_WriteIndex(0xB4); //Column inversion 
	Lcd_WriteData(0x07); 

	//ST7735R Power Sequence
	Lcd_WriteIndex(0xC0); 
	Lcd_WriteData(0xA2); 
	Lcd_WriteData(0x02); 
	Lcd_WriteData(0x84); 
	Lcd_WriteIndex(0xC1); 
	Lcd_WriteData(0xC5); 

	Lcd_WriteIndex(0xC2); 
	Lcd_WriteData(0x0A); 
	Lcd_WriteData(0x00); 

	Lcd_WriteIndex(0xC3); 
	Lcd_WriteData(0x8A); 
	Lcd_WriteData(0x2A); 
	Lcd_WriteIndex(0xC4); 
	Lcd_WriteData(0x8A); 
	Lcd_WriteData(0xEE); 

	Lcd_WriteIndex(0xC5); //VCOM 
	Lcd_WriteData(0x0E); 

	Lcd_WriteIndex(0x36); //MX, MY, RGB mode 
	Lcd_WriteData(0xC0); 

	//ST7735R Gamma Sequence
	Lcd_WriteIndex(0xe0); 
	Lcd_WriteData(0x0f); 
	Lcd_WriteData(0x1a); 
	Lcd_WriteData(0x0f); 
	Lcd_WriteData(0x18); 
	Lcd_WriteData(0x2f); 
	Lcd_WriteData(0x28); 
	Lcd_WriteData(0x20); 
	Lcd_WriteData(0x22); 
	Lcd_WriteData(0x1f); 
	Lcd_WriteData(0x1b); 
	Lcd_WriteData(0x23); 
	Lcd_WriteData(0x37); 
	Lcd_WriteData(0x00); 	
	Lcd_WriteData(0x07); 
	Lcd_WriteData(0x02); 
	Lcd_WriteData(0x10); 

	Lcd_WriteIndex(0xe1); 
	Lcd_WriteData(0x0f); 
	Lcd_WriteData(0x1b); 
	Lcd_WriteData(0x0f); 
	Lcd_WriteData(0x17); 
	Lcd_WriteData(0x33); 
	Lcd_WriteData(0x2c); 
	Lcd_WriteData(0x29); 
	Lcd_WriteData(0x2e); 
	Lcd_WriteData(0x30); 
	Lcd_WriteData(0x30); 
	Lcd_WriteData(0x39); 
	Lcd_WriteData(0x3f); 
	Lcd_WriteData(0x00); 
	Lcd_WriteData(0x07); 
	Lcd_WriteData(0x03); 
	Lcd_WriteData(0x10);  

	Lcd_WriteIndex(0x2a);
	Lcd_WriteData(0x00);
	Lcd_WriteData(0x00);
	Lcd_WriteData(0x00);
	Lcd_WriteData(0x7f);

	Lcd_WriteIndex(0x2b);
	Lcd_WriteData(0x00);
	Lcd_WriteData(0x00);
	Lcd_WriteData(0x00);
	Lcd_WriteData(0x9f);

	Lcd_WriteIndex(0xF0); //Enable test command  
	Lcd_WriteData(0x01); 
	Lcd_WriteIndex(0xF6); //Disable ram power save mode 
	Lcd_WriteData(0x00); 

	Lcd_WriteIndex(0x3A); //65k mode 
	Lcd_WriteData(0x05); 


	Lcd_WriteIndex(0x29);//Display on	 
	
	LCD_LED_SET();
}


/*************************************************
函数名：LCD_Set_Region
功能：设置lcd显示区域，在此区域写点数据自动换行
入口参数：xy起点和终点
返回值：无
*************************************************/
void Lcd_SetRegion(uint16_t x_start,uint16_t y_start,uint16_t x_end,uint16_t y_end)
{		
	Lcd_WriteIndex(0x2a);
	Lcd_WriteData(0x00);
	Lcd_WriteData(x_start+2);
	Lcd_WriteData(0x00);
	Lcd_WriteData(x_end+2);

	Lcd_WriteIndex(0x2b);
	Lcd_WriteData(0x00);
	Lcd_WriteData(y_start+1);
	Lcd_WriteData(0x00);
	Lcd_WriteData(y_end+1);

	Lcd_WriteIndex(0x2c);
}

/*************************************************
函数名：LCD_Set_XY
功能：设置lcd显示起始点
入口参数：xy坐标
返回值：无
*************************************************/
void Lcd_SetXY(uint16_t x,uint16_t y)
{
	Lcd_SetRegion(x,y,x,y);
}

	
/*************************************************
函数名：LCD_DrawPoint
功能：画一个点
入口参数：无
返回值：无
*************************************************/
void Gui_DrawPoint(uint16_t x,uint16_t y,uint16_t Data)
{
	Lcd_SetRegion(x,y,x+1,y+1);
	LCD_WriteData_16Bit(Data);
}

/*****************************************
 函数功能：读TFT某一点的颜色                          
 出口参数：color  点颜色值                                 
******************************************/
unsigned int Lcd_ReadPoint(uint16_t x,uint16_t y)
{
	unsigned int Data;
	Lcd_SetXY(x,y);

	//Lcd_ReadData();//丢掉无用字节
	//Data=Lcd_ReadData();
	Lcd_WriteData(Data);
	return Data;
}
/*************************************************
函数名：Lcd_Clear
功能：全屏清屏函数
入口参数：填充颜色COLOR
返回值：无
*************************************************/
void Lcd_Clear(uint16_t Color)               
{	
	unsigned int i,m;
	Lcd_SetRegion(0,0,X_MAX_PIXEL-1,Y_MAX_PIXEL-1);
	Lcd_WriteIndex(0x2C);
	for(i=0;i<X_MAX_PIXEL;i++)
	for(m=0;m<Y_MAX_PIXEL;m++)
	{	
		LCD_WriteData_16Bit(Color);
	}   
}
















const unsigned char asc16[]={
0x00,0x00,0x00,0x00,0x00,0x00,0x00,0x00,0x00,0x00,0x00,0x00,0x00,0x00,0x00,0x00, //" "
0x00,0x10,0x10,0x10,0x10,0x10,0x10,0x10,0x10,0x10,0x00,0x00,0x10,0x10,0x00,0x00, //"!"
0x00,0x00,0x6C,0x6C,0x24,0x24,0x00,0x00,0x00,0x00,0x01,0x00,0x00,0x00,0x00,0x00, //"""
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0x00,
};

void Gui_DrawFont_GBK16(uint16_t x, uint16_t y, uint16_t fc, uint16_t bc, uint8_t *s)
{
	unsigned char i,j;
	unsigned short k,x0;
	x0=x;

	while(*s) 
	{	
		if((*s) < 128) 
		{
			k=*s;
			if (k==13) 
			{
				x=x0;
				y+=16;
			}
			else 
			{
				if (k>32) k-=32; else k=0;
	
			    for(i=0;i<16;i++)
				for(j=0;j<8;j++) 
					{
				    	if(asc16[k*16+i]&(0x80>>j))	Gui_DrawPoint(x+j,y+i,fc);
						else 
						{
							if (fc!=bc) Gui_DrawPoint(x+j,y+i,bc);
						}
					}
				x+=8;
			}
			s++;
		}
	}
}

void lcd_test(void)
{
	uint8_t frame = 0;
	uint8_t second = 0;
	uint8_t minute = 0;
	uint8_t hour = 0;
	uint8_t lcd_str[32] = {0};
	
	sprintf((char *)lcd_str, "%02d:%02d:%02d %02d", hour, minute, second, frame);
	Gui_DrawFont_GBK16(16,10,WHITE,BLACK,lcd_str);	
}

void Gui_DrawFont_GBK16_FullLCD(uint16_t fc, uint16_t bc, uint8_t *s)
{
	unsigned char i,j;
	unsigned short k,x0;
	unsigned char x_index = 0;
	uint16_t x = 0;
	uint16_t y = 0;
	x0=x;

	while(*s) 
	{	
		if((*s) < 128) 
		{
			k=*s;
			if (k==13)
			{
				x_index = 0;
				x=x0;
				y+=16;
			}
			else 
			{
				if (x_index == 15)
				{
					x_index = 0;
					x=x0;
					y+=16;
				}
				if (k>32) k-=32; else k=0;
	
			    for(i=0;i<16;i++)
				for(j=0;j<8;j++) 
					{
				    	if(asc16[k*16+i]&(0x80>>j))	Gui_DrawPoint(x+j,y+i,fc);
						else 
						{
							if (fc!=bc) Gui_DrawPoint(x+j,y+i,bc);
						}
					}
				x+=8;
			}
			s++;
			x_index++;
		}
	}
}

void lcd_printf(const char *fmt /*format*/, ...)
{
	va_list ap;
	uint8_t lcd_str[256] = {0};
	va_start(ap, fmt);
	vsprintf((char *)lcd_str, fmt, ap);
	Lcd_Clear(BLACK);
    Gui_DrawFont_GBK16_FullLCD(WHITE,BLACK,lcd_str);
	va_end(ap);
}

void lcd_high_update(uint8_t display_high1, uint8_t display_high2, uint8_t display_high3)
{
	static uint8_t step = 0;
	static uint8_t high1 = 0;
	static uint8_t high2 = 0;
	static uint8_t high3 = 0;
	
	static uint16_t x = 0;
	static uint16_t y = 0;
	uint8_t i = 0;
	
	switch (step)
	{
		case 0:
			x = 30;
		    y = 60;
			high1 = (255-display_high1)/3;
			high2 = (255-display_high2)/3;
			high3 = (255-display_high3)/3;
			for (i=0; i<high1; i++)
			{
				Gui_DrawPoint(x,y+i,BLACK);
			}
			for (; i<(255/3); i++)
			{
				Gui_DrawPoint(x,y+i,WHITE);
			}
			step = 1;
			break;
		case 1:
			x = 60;
			for (i=0; i<high2; i++)
			{
				Gui_DrawPoint(x,y+i,BLACK);
			}
			for (; i<(255/3); i++)
			{
				Gui_DrawPoint(x,y+i,WHITE);
			}
			step = 2;
			break;
		case 2:
			x = 90;
			for (i=0; i<high3; i++)
			{
				Gui_DrawPoint(x,y+i,BLACK);
			}
			for (; i<(255/3); i++)
			{
				Gui_DrawPoint(x,y+i,WHITE);
			}
			step = 0;
			break;
		default :
			step = 0;
			break;
	}
}
